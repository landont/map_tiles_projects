## 01.Simple_Map/waveshare_esp32_s3_touch_lcd_3_5b/components/esp32_s3_touch_lcd_3_5b/Kconfig
```kconfig
menu "Board Support Package (Waveshare ESP32-S3-Touch-LCD-3.5B)"

    config BSP_I2C_NUM
        int "I2C peripheral number"
        default 0
        range 0 1
        help
            The I2C peripheral used for onboard peripherals.

    config BSP_I2C_CLK_SPEED_HZ
        int "I2C clock speed in Hz"
        default 400000
        range 100000 1000000
        help
            I2C clock speed in Hz.

    menu "Display Configuration"
        config BSP_DISPLAY_LVGL_BUF_HEIGHT
            int "LVGL buffer height"
            default 100
            range 10 480
            help
                Height of the LVGL buffer in pixels.

        config BSP_DISPLAY_LVGL_TICK
            int "LVGL tick period (ms)"
            default 2
            range 1 100
            help
                LVGL tick period in milliseconds.

        config BSP_DISPLAY_LVGL_MAX_SLEEP
            int "LVGL max sleep (ms)"
            default 500
            range 100 5000
            help
                Maximum sleep time for LVGL in milliseconds.

        config BSP_DISPLAY_BRIGHTNESS_LEDC_CH
            int "LEDC channel for backlight"
            default 1
            range 0 7
            help
                LEDC channel used for controlling the backlight brightness.
    endmenu

    menu "SD Card Configuration"
        config BSP_SD_MOUNT_POINT
            string "SD card mount point"
            default "/sdcard"
            help
                Mount point for the SD card filesystem.
    endmenu

    menu "SPIFFS Configuration"
        config BSP_SPIFFS_MOUNT_POINT
            string "SPIFFS mount point"
            default "/spiffs"
            help
                Mount point for the SPIFFS filesystem.

        config BSP_SPIFFS_PARTITION_LABEL
            string "SPIFFS partition label"
            default "storage"
            help
                Partition label for SPIFFS.

        config BSP_SPIFFS_MAX_FILES
            int "Maximum number of open files"
            default 5
            range 1 10
            help
                Maximum number of files that can be open at the same time.
    endmenu

endmenu
```

## 01.Simple_Map/waveshare_esp32_s3_touch_lcd_3_5b/sdkconfig.defaults
```kconfig
# ESP32-S3-Touch-LCD-3.5B sdkconfig defaults

# Target chip
CONFIG_IDF_TARGET="esp32s3"

# CPU frequency
CONFIG_ESP_DEFAULT_CPU_FREQ_MHZ_240=y

# Partition table
CONFIG_PARTITION_TABLE_CUSTOM=y
CONFIG_PARTITION_TABLE_CUSTOM_FILENAME="partitions.csv"

# Flash size (16MB)
CONFIG_ESPTOOLPY_FLASHSIZE_16MB=y
CONFIG_ESPTOOLPY_FLASHSIZE="16MB"

# PSRAM configuration (8MB Octal PSRAM)
CONFIG_SPIRAM=y
CONFIG_SPIRAM_MODE_OCT=y
CONFIG_SPIRAM_SPEED_80M=y
CONFIG_SPIRAM_BOOT_INIT=y
CONFIG_SPIRAM_IGNORE_NOTFOUND=n
CONFIG_SPIRAM_USE_MALLOC=y
CONFIG_SPIRAM_MALLOC_ALWAYSINTERNAL=16384
CONFIG_SPIRAM_MALLOC_RESERVE_INTERNAL=32768

# Compiler optimizations
CONFIG_COMPILER_OPTIMIZATION_PERF=y

# FreeRTOS
CONFIG_FREERTOS_HZ=1000
CONFIG_FREERTOS_TIMER_TASK_STACK_DEPTH=3072

# Main task stack size (increased for LVGL operations)
CONFIG_ESP_MAIN_TASK_STACK_SIZE=16384

# Logging
CONFIG_LOG_DEFAULT_LEVEL_INFO=y

# LVGL configuration
CONFIG_LV_USE_ASSERT_NULL=y
CONFIG_LV_USE_ASSERT_MALLOC=y
CONFIG_LV_USE_ASSERT_MEM_INTEGRITY=n
CONFIG_LV_USE_ASSERT_OBJ=n
CONFIG_LV_USE_ASSERT_STYLE=n
CONFIG_LV_COLOR_DEPTH_16=y
CONFIG_LV_COLOR_16_SWAP=y
CONFIG_LV_MEM_CUSTOM=y
CONFIG_LV_FONT_MONTSERRAT_14=y
CONFIG_LV_FONT_MONTSERRAT_16=y
# LVGL FatFS driver disabled - map_tiles component handles file I/O directly
CONFIG_LV_USE_FS_FATFS=n

# BSP Configuration
CONFIG_BSP_I2C_NUM=0
CONFIG_BSP_I2C_CLK_SPEED_HZ=400000
CONFIG_BSP_DISPLAY_LVGL_BUF_HEIGHT=100
CONFIG_BSP_DISPLAY_LVGL_TICK=2
CONFIG_BSP_DISPLAY_LVGL_MAX_SLEEP=500
CONFIG_BSP_DISPLAY_BRIGHTNESS_LEDC_CH=1
CONFIG_BSP_SD_MOUNT_POINT="/sdcard"
CONFIG_BSP_SPIFFS_MOUNT_POINT="/spiffs"
CONFIG_BSP_SPIFFS_PARTITION_LABEL="storage"
CONFIG_BSP_SPIFFS_MAX_FILES=5

# SD/MMC configuration
CONFIG_FATFS_LONG_FILENAMES=y
CONFIG_FATFS_LFN_HEAP=y
CONFIG_FATFS_MAX_LFN=255

# SPI configuration
CONFIG_SPI_MASTER_ISR_IN_IRAM=y
CONFIG_SPI_SLAVE_ISR_IN_IRAM=y
```
